## drivers/soc/qcom/Kconfig
```kconfig
# SPDX-License-Identifier: GPL-2.0-only
#
# QCOM Soc drivers
#
menu "Qualcomm SoC drivers"

config QCOM_AOSS_QMP
	tristate "Qualcomm AOSS Driver"
	depends on ARCH_QCOM || COMPILE_TEST
	depends on MAILBOX
	depends on COMMON_CLK && PM
	select PM_GENERIC_DOMAINS
	help
	  This driver provides the means of communicating with and controlling
	  the low-power state for resources related to the remoteproc
	  subsystems as well as controlling the debug clocks exposed by the Always On
	  Subsystem (AOSS) using Qualcomm Messaging Protocol (QMP).

config QCOM_COMMAND_DB
	tristate "Qualcomm Command DB"
	depends on ARCH_QCOM || COMPILE_TEST
	depends on OF_RESERVED_MEM
	help
	  Command DB queries shared memory by key string for shared system
	  resources. Platform drivers that require to set state of a shared
	  resource on a RPM-hardened platform must use this database to get
	  SoC specific identifier and information for the shared resources.

config QCOM_DCC_V2
       tristate "Qualcomm Technologies Data Capture and Compare enigne support for V2"
       help
         This option enables driver for Data Capture and Compare engine. DCC
         driver provides interface to configure DCC block and read back
         captured data from DCC's internal SRAM.

config QCOM_GENI_SE
	tristate "QCOM GENI Serial Engine Driver"
	depends on ARCH_QCOM || COMPILE_TEST
	help
	  This driver is used to manage Generic Interface (GENI) firmware based
	  Qualcomm Technologies, Inc. Universal Peripheral (QUP) Wrapper. This
	  driver is also used to manage the common aspects of multiple Serial
	  Engines present in the QUP.

config QCOM_GENI_SE_SSC
	tristate "QCOM GENI SSC Serial Engine Driver"
	depends on QCOM_GENI_SE
	help
	  This driver is used to manage SSR aspects of multiple Serial
	  Engines present in the QUP.

	  This driver can also be built as a module. If so, the module
	  will be called qcom-geni-se-ssc.

config QCOM_GSBI
	tristate "QCOM General Serial Bus Interface"
	depends on ARCH_QCOM || COMPILE_TEST
	select MFD_SYSCON
	help
	  Say y here to enable GSBI support.  The GSBI provides control
	  functions for connecting the underlying serial UART, SPI, and I2C
	  devices to the output pins.

config QCOM_LLCC
	tristate "Qualcomm Technologies, Inc. LLCC driver"
	depends on ARCH_QCOM || COMPILE_TEST
	select REGMAP_MMIO
	help
	  Qualcomm Technologies, Inc. platform specific
	  Last Level Cache Controller(LLCC) driver for platforms such as,
	  SDM845. This provides interfaces to clients that use the LLCC.
	  Say yes here to enable LLCC slice driver.

config QCOM_KRYO_L2_ACCESSORS
	bool
	depends on (ARCH_QCOM || COMPILE_TEST) && ARM64

config QCOM_MDT_LOADER
	tristate
	select QCOM_SCM

config QCOM_OCMEM
	tristate "Qualcomm On Chip Memory (OCMEM) driver"
	depends on ARCH_QCOM
	select QCOM_SCM
	help
	  The On Chip Memory (OCMEM) allocator allows various clients to
	  allocate memory from OCMEM based on performance, latency and power
	  requirements. This is typically used by the GPU, camera/video, and
	  audio components on some Snapdragon SoCs.

config QCOM_PD_MAPPER
	tristate "Qualcomm Protection Domain Mapper"
	select QCOM_QMI_HELPERS
	select QCOM_PDR_MSG
	select AUXILIARY_BUS
	depends on NET && QRTR && (ARCH_QCOM || COMPILE_TEST)
	default QCOM_RPROC_COMMON
	help
	  The Protection Domain Mapper maps registered services to the domains
	  and instances handled by the remote DSPs. This is a kernel-space
	  implementation of the service. It is a simpler alternative to the
	  userspace daemon.

config QCOM_PDR_HELPERS
	tristate
	select QCOM_QMI_HELPERS
	select QCOM_PDR_MSG
	depends on NET

config QCOM_PDR_MSG
	tristate

config QCOM_PMIC_PDCHARGER_ULOG
	tristate "Qualcomm PMIC PDCharger ULOG driver"
	depends on RPMSG
	depends on EVENT_TRACING
	help
	  The Qualcomm PMIC PDCharger ULOG driver provides access to logs of
	  the ADSP firmware PDCharger module in charge of Battery and Power
	  Delivery on modern systems.

	  Say yes here to support PDCharger ULOG event tracing on modern
	  Qualcomm platforms.

config QCOM_PMIC_GLINK
	tristate "Qualcomm PMIC GLINK driver"
	depends on RPMSG
	depends on TYPEC
	depends on DRM
	depends on NET
	depends on OF
	select AUXILIARY_BUS
	select QCOM_PDR_HELPERS
	select DRM_AUX_HPD_BRIDGE
	help
	  The Qualcomm PMIC GLINK driver provides access, over GLINK, to the
	  USB and battery firmware running on one of the coprocessors in
	  several modern Qualcomm platforms.

	  Say yes here to support USB-C and battery status on modern Qualcomm
	  platforms.

config QCOM_QMI_HELPERS
	tristate
	depends on NET

config QCOM_RAMP_CTRL
	tristate "Qualcomm Ramp Controller driver"
	depends on ARCH_QCOM || COMPILE_TEST
	help
	  The Ramp Controller is used to program the sequence ID for pulse
	  swallowing, enable sequence and link sequence IDs for the CPU
	  cores on some Qualcomm SoCs.
	  Say y here to enable support for the ramp controller.

config QCOM_RMTFS_MEM
	tristate "Qualcomm Remote Filesystem memory driver"
	depends on ARCH_QCOM || COMPILE_TEST
	select QCOM_SCM
	help
	  The Qualcomm remote filesystem memory driver is used for allocating
	  and exposing regions of shared memory with remote processors for the
	  purpose of exchanging sector-data between the remote filesystem
	  service and its clients.

	  Say y here if you intend to boot the modem remoteproc.

config QCOM_QFPROM_SYS
	tristate "Qualcomm Technologies, Inc. QFPROM_SYS driver "
	depends on NVMEM_QCOM_QFPROM
	help
	  Qualcomm Technologies, Inc. QFPROM_SYS driver. The QFPROM SYS driver
	  provides access to the child nodes of QFPROM to user space. The cell
	  values are exported as sysfs entries.

	  Say y here to enable QFPROM SYS support.

config MSM_CORE_HANG_DETECT
        tristate "MSM Core Hang Detection Support"
        help
          This enables the core hang detection module. It causes SoC
          reset on core hang detection and collects the core context
          for hang. By using sysfs entries core hang detection can be
          enabled or disabled dynamically.

config QCOM_RPM_MASTER_STATS
	tristate "Qualcomm RPM Master stats"
	depends on ARCH_QCOM || COMPILE_TEST
	help
	  The RPM Master sleep stats driver provides detailed per-subsystem
	  sleep/wake data, read from the RPM message RAM. It can be used to
	  assess whether all the low-power modes available are entered as
	  expected or to check which part of the SoC prevents it from sleeping.

	  Say y here if you intend to debug or monitor platform sleep.

config QCOM_RPMH
	tristate "Qualcomm RPM-Hardened (RPMH) Communication"
	depends on ARCH_QCOM || COMPILE_TEST
	depends on (QCOM_COMMAND_DB || !QCOM_COMMAND_DB)
	help
	  Support for communication with the hardened-RPM blocks in
	  Qualcomm Technologies Inc (QTI) SoCs. RPMH communication uses an
	  internal bus to transmit state requests for shared resources. A set
	  of hardware components aggregate requests for these resources and
	  help apply the aggregated state on the resource.

config QCOM_RUN_QUEUE_STATS
       tristate "Enable collection and exporting of QTI Run Queue stats to userspace"
       help
        This option enables the driver to periodically collecting the statistics
        of kernel run queue information and calculate the load of the system.
        This information is exported to usespace via sysfs entries and userspace
        algorithms uses info and decide when to turn on/off the cpu cores.

config QCOM_SMEM
	tristate "Qualcomm Shared Memory Manager (SMEM)"
	depends on ARCH_QCOM || COMPILE_TEST
	depends on HWSPINLOCK
	help
	  Say y here to enable support for the Qualcomm Shared Memory Manager.
	  The driver provides an interface to items in a heap shared among all
	  processors in a Qualcomm platform.

config QCOM_SMD_RPM
	tristate "Qualcomm Resource Power Manager (RPM) over SMD"
	depends on ARCH_QCOM || COMPILE_TEST
	depends on RPMSG
	depends on RPMSG_QCOM_SMD || RPMSG_QCOM_SMD=n
	help
	  If you say yes to this option, support will be included for the
	  Resource Power Manager system found in the Qualcomm 8974 based
	  devices.

	  This is required to access many regulators, clocks and bus
	  frequencies controlled by the RPM on these devices.

	  Say M here if you want to include support for the Qualcomm RPM as a
	  module. This will build a module called "qcom-smd-rpm".

config QCOM_MEMORY_DUMP_V2
	tristate "QCOM Memory Dump V2 Support"
	help
	  This enables memory dump feature. It allows various client
	  subsystems to register respective dump regions. At the time
	  of deadlocks or cpu hangs these dump regions are captured to
	  give a snapshot of the system at the time of the crash.

config QCOM_SMEM_STATE
	bool

config QCOM_SMP2P
	tristate "Qualcomm Shared Memory Point to Point support"
	depends on MAILBOX
	depends on QCOM_SMEM
	select QCOM_SMEM_STATE
	select IRQ_DOMAIN
	help
	  Say yes here to support the Qualcomm Shared Memory Point to Point
	  protocol.

config QCOM_SMSM
	tristate "Qualcomm Shared Memory State Machine"
	depends on MAILBOX
	depends on QCOM_SMEM
	select QCOM_SMEM_STATE
	select IRQ_DOMAIN
	help
	  Say yes here to support the Qualcomm Shared Memory State Machine.
	  The state machine is represented by bits in shared memory.

config QCOM_SMP2P_SLEEPSTATE
	tristate "SMP2P Sleepstate notifier"
	depends on QCOM_SMP2P
	help
	  When this option is enabled, notifications are sent to remote procs
	  for the power state changes on the local processor. The notifications
	  are sent through the smp2p framework. This driver can also receive
	  notifications from the remote to prevent suspend on the local
	  processor.

config QSEE_IPC_IRQ_BRIDGE
	tristate "QSEE IPC Interrupt Bridge"
	help
	  This module enables bridging an Inter-Processor Communication(IPC)
	  interrupt from a remote subsystem directed towards
	  Qualcomm Technologies, Inc. Secure Execution Environment(QSEE) to
	  userspace. The interrupt will be propagated through a character device
	  that userspace clients can poll on.

config QCOM_GLINK
	tristate "GLINK Probe Helper"
	depends on RPMSG_QCOM_GLINK_SMEM
	help
	  This enables the GLINK Probe module. This is designed to set up
	  other edges in the system. It will initialize all the transports for
	  all the edges present in the device.
	  Say M if you want to enable this module.

config QCOM_SECURE_BUFFER
	tristate "Helper functions for secure buffers through TZ"
	depends on QCOM_SCM
	help
	  Enable for targets that need to call into TZ to secure
	  memory buffers. This ensures that only the correct clients can
	  use this memory and no unauthorized access is made to the
	  buffer.

config QCOM_SOCINFO
	tristate "Qualcomm socinfo driver"
	depends on QCOM_SMEM
	select SOC_BUS
	help
	 Say yes here to support the Qualcomm socinfo driver, providing
	 information about the SoC to user space.

config QCOM_SPM
	tristate "Qualcomm Subsystem Power Manager (SPM)"
	depends on ARCH_QCOM || COMPILE_TEST
	select QCOM_SCM
	help
	  Enable the support for the Qualcomm Subsystem Power Manager, used
	  to manage cores, L2 low power modes and to configure the internal
	  Adaptive Voltage Scaler parameters, where supported.

config QCOM_STATS
	tristate "Qualcomm Technologies, Inc. (QTI) Sleep stats driver"
	depends on (ARCH_QCOM && DEBUG_FS) || COMPILE_TEST
	depends on QCOM_SMEM
	depends on QCOM_AOSS_QMP || QCOM_AOSS_QMP=n
	help
	  Qualcomm Technologies, Inc. (QTI) Sleep stats driver to read
	  the shared memory exported by the remote processor related to
	  various SoC level low power modes statistics and export to debugfs
	  interface.

config QCOM_WDT_CORE
	tristate "Qualcomm Technologies, Inc. Watchdog Support"
	depends on ARCH_QCOM
	help
	   This enables the watchdog framework for Qualcomm Technologies, Inc.
	   devices. It causes a kernel panic if the watchdog times out. It allows
	   for the detection of cpu hangs and deadlocks. It does not run during the
	   bootup process, so it will not catch any early lockups. Enabling this
	   only enables the framework, an individual Qualcomm Technologies, Inc.
	   watchdog module must be loaded along with this for watchdog
	   functionality.

config QCOM_SOC_WATCHDOG
	tristate "Qualcomm Technologies, Inc. Soc Watchdog"
	depends on QCOM_WDT_CORE
	help
	  This enables the Qualcomm Technologies, Inc. watchdog module for the
	  Soc. It provides an interface to perform watchdog actions such as
	  setting the bark/bite time and also petting the hardware watchdog. To
	  utilize this the Qualcomm Technologies, Inc. watchdog framework must
	  also be enabled.

config QCOM_IRQ_STAT
	bool "QCOM IRQ stats"
	default y
	depends on QCOM_WDT_CORE && ANDROID_VENDOR_OEM_DATA
	help
	  This give irq stats for top hitter at
	  watchdog bark and kernel panics.
	  This provides additional debug information
	  for irq counts.

config QCOM_WATCHDOG_IPI_PING
	depends on QCOM_WDT_CORE
	bool "Qualcomm Technologies, Inc. Watchdog ipi ping"
	default y
	help
	  This boolean flag gives the watchdog driver the ability to send a
	  keep-alive ping to other cpu's if it is set to 1. Otherwise, when
	  it is set to 0 no keep alive pings will be sent.

config QCOM_WCNSS_CTRL
	tristate "Qualcomm WCNSS control driver"
	depends on ARCH_QCOM || COMPILE_TEST
	depends on RPMSG
	help
	  Client driver for the WCNSS_CTRL SMD channel, used to download nv
	  firmware to a newly booted WCNSS chip.

config QCOM_APR
	tristate "Qualcomm APR/GPR Bus (Asynchronous/Generic Packet Router)"
	depends on ARCH_QCOM || COMPILE_TEST
	depends on RPMSG
	depends on NET
	select QCOM_PDR_HELPERS
	help
	  Enable APR IPC protocol support between
	  application processor and QDSP6. APR is
	  used by audio driver to configure QDSP6
	  ASM, ADM and AFE modules.

config MSM_BOOT_STATS
	tristate "Use MSM boot stats reporting"
	help
	  Use this to report msm boot stats such as bootloader throughput,
	  display init, total boot time.
	  This figures are reported in mpm sleep clock cycles and have a
	  resolution of 31 bits as 1 bit is used as an overflow check.

config QCOM_CPU_VENDOR_HOOKS
        tristate "QTI Vendor Hooks Support"
        depends on ARCH_QCOM && ANDROID_VENDOR_HOOKS
        help
          CPU vendor hooks driver registers with andriod vendor hooks
          provided by core kernel to extend kernel functionality.

          Currently these features are not supported by upstream kernel and not
          having scope to upstream.
          If unsure, say N.

config QTI_CRYPTO_COMMON
	tristate "Enable common crypto functionality used for FBE"
	depends on SCSI_UFS_CRYPTO_QTI || MMC_CRYPTO_QTI
	help
	 Say 'Y' to enable the common crypto implementation to be used by
	 different storage layers such as UFS and EMMC for file based hardware
	 encryption. This library implements API to program and evict
	 keys using Trustzone or Hardware Key Manager.

config QTI_CRYPTO_TZ
	tristate "Enable Trustzone to be used for FBE"
	depends on QTI_CRYPTO_COMMON
	help
	 Say 'Y' to enable routing crypto requests to Trustzone while
	 performing hardware based file encryption. This means keys are
	 programmed and managed through SCM calls to TZ where ICE driver
	 will configure keys.

config QCOM_MINIDUMP
	tristate "QCOM Minidump Support"
	depends on QCOM_SMEM || GUNYAH_DRIVERS
	help
	  This enables minidump feature. It allows various clients to
	  register to dump their state at system bad state (panic/WDT,etc.,).
	  Minidump would dump all registered entries, only when DLOAD mode
	  is enabled.

config QCOM_MINIDUMP_SMEM
	bool "QCOM Minidump SMEM Support"
	depends on QCOM_MINIDUMP && QCOM_SMEM
	default y
	help
	  This enables minidump smem transport layer.
	  If minidump and smem are enabled,
	  this config option shall be enabled by
	  default.

config QCOM_CDSP_RM
	tristate "CDSP request manager"
	depends on RPMSG
	help
	  This driver serves CDSP requests for CPU L3 clock and CPU QoS thus
	  improving CDSP performance. Using this driver, CDSP can set appropriate
	  CPU L3 clock for improving IO-Coherent throughput and opt for QoS mode
	  to improve RPC latency. The driver also registers cooling devices for
	  CDSP subsystem and implements Cx ipeak limit management.

config QCOM_RAMDUMP
	tristate "Qualcomm Technologies, Inc. Ramdump driver"
	default n
	help
	  This option enables the QTI ramdump driver. The ramdump driver
	  provides APIs to collect ramdumps which can be extracted from
	  userspace. Say 'Y' here to enable this driver. It's safe to say
	  'N' here if you don't plan on collecting ramdumps.

config QCOM_ICC_BWMON
	tristate "QCOM Interconnect Bandwidth Monitor driver"
	depends on ARCH_QCOM || COMPILE_TEST
	select PM_OPP
	select REGMAP_MMIO
	help
	  Sets up driver monitoring bandwidth on various interconnects and
	  based on that voting for interconnect bandwidth, adjusting their
	  speed to current demand.
	  Current implementation brings support for BWMON v4, used for example
	  on SDM845 to measure bandwidth between CPU (gladiator_noc) and Last
	  Level Cache (memnoc).  Usage of this BWMON allows to remove some of
	  the fixed bandwidth votes from cpufreq (CPU nodes) thus achieve high
	  memory throughput even with lower CPU frequencies.

config QCOM_DEBUG_SYMBOL
	tristate "Enable Debug Symbol Support"
	depends on ANDROID_DEBUG_KINFO
	help
	  This enables Debug Symbol Support. This driver is based on
	  Google Debug Kinfo driver, according to the provided info, this
	  driver allows other modules to get symbol addresses by traversing
	  kallsyms table for debug usage.

config MSM_PERFORMANCE
        tristate "msm performance driver to support userspace fmin/fmax request"
        help
          This driver can restrict max freq or min freq of cpu cluster
          when requested by the userspace by changing the cpufreq policy
          fmin and fmax. The user space can request  the cpu freq change by
          writing cpu#:freq values

config QCOM_PANEL_EVENT_NOTIFIER
	tristate "panel event notifier"
	depends on DRM
	help
	  Enabling this option adds panel event notifier driver.
	  This driver is responsible for notifying clients interested in display
	  panel events such as panel on , panel off, fps change etc.  Clients
	  can use these notifications for power saving or align its operations
	  with display panel power state.

config QCOM_S2D_VENDOR_HOOK
	tristate "Vendor hook module to route flow of the core Kernel"
	help
	  This options enable vendor hook callbacks for bootloader based
	  hibernation. Callbacks implemented here are called from the
          core kernel and help to do bootloader hibernation specific job.
	  Enable this if bootloader hibernation is enabled.

config QCOM_INLINE_CRYPTO_ENGINE
	tristate
	select QCOM_SCM

config QCOM_PBS
	tristate "PBS trigger support for Qualcomm Technologies, Inc. PMICS"
	depends on SPMI
	help
	  This driver supports configuring software programmable boot sequencer (PBS)
	  trigger event through PBS RAM on Qualcomm Technologies, Inc. PMICs.
	  This module provides the APIs to the client drivers that wants to send the
	  PBS trigger event to the PBS RAM.

config K61_SUBSYS_SHIM
	bool "msm_subsys sysfs shim for the 4.14 vendor userspace"
	depends on QCOM_COMMON || ARCH_QCOM
	help
	  Exposes /sys/bus/msm_subsys/devices/subsysN/{name,state,...} backed by
	  remoteproc SSR notifications, as libmdmdetect/pd-mapper/per_mgr expect.

source "drivers/soc/qcom/mem_buf/Kconfig"
source "drivers/soc/qcom/dcvs/Kconfig"
endmenu

config QCOM_UBWC_CONFIG
	tristate
	help
	  Most Qualcomm SoCs feature a number of Universal Bandwidth Compression
	  (UBWC) engines across various IP blocks, which need to be initialized
	  with coherent configuration data. This module functions as a single
	  source of truth for that information.
```
