## drivers/dma-buf/heaps/Kconfig
```kconfig
config DMABUF_HEAPS_SYSTEM
	tristate "DMA-BUF System Heap"
	depends on DMABUF_HEAPS
	help
	  Choose this option to enable the system dmabuf heap. The system heap
	  is backed by pages from the buddy allocator. If in doubt, say Y.

config DMABUF_HEAPS_CMA
	tristate "DMA-BUF CMA Heap"
	depends on DMABUF_HEAPS && DMA_CMA
	help
	  Choose this option to enable dma-buf CMA heap. This heap is backed
	  by the Contiguous Memory Allocator (CMA). If your system has these
	  regions, you should say Y here.

config DMABUF_HEAPS_CMA_LEGACY
	bool "Legacy DMA-BUF CMA Heap"
	default y
	depends on DMABUF_HEAPS_CMA
	help
	  Add a duplicate CMA-backed dma-buf heap with legacy naming derived
	  from the CMA area's devicetree node, or "reserved" if the area is not
	  defined in the devicetree. This uses the same underlying allocator as
	  CONFIG_DMABUF_HEAPS_CMA.

config QCOM_LEGACY_ION
	bool "/dev/ion for Android 11 vendor userspace"
	depends on QCOM_DMABUF_HEAPS
	help
	  Provide the /dev/ion interface of 5.4 GKI modular ION (ABI version
	  2, msm heap IDs) on top of the qcom DMA-BUF heaps, for vendor
	  blobs built against the VNDK v30 libion.
```

## drivers/input/fingerprint/fpc_tee/Kconfig
```kconfig
# SPDX-License-Identifier: GPL-2.0-only
config FINGERPRINT_FPC_TEE
	tristate "FPC1020 fingerprint sensor (sweet TEE variant)"
	depends on INPUT_FINGERPRINT && OF && GPIOLIB
	depends on !FINGERPRINT_FPC1020
	help
	  Platform driver for the FPC1020 sensor as wired on sweet: it only
	  powers, resets and forwards the IRQ of the sensor; the TEE talks to
	  it over SPI. The GPIOs and the IRQ are requested on demand through
	  sysfs, so it coexists with the FortSense driver on the same pins.

	  It binds "fpc,fpc1020" like FINGERPRINT_FPC1020 (violet), so only
	  one of the two can be enabled.
```

## drivers/input/fingerprint/fs_tee/Kconfig
```kconfig
# SPDX-License-Identifier: GPL-2.0-only
config FINGERPRINT_FS_TEE
	tristate "FortSense fingerprint sensor (TEE)"
	depends on INPUT_FINGERPRINT && OF && GPIOLIB
	help
	  Power, reset and IRQ control for the FortSense sensor on sweet.
	  The sensor is driven over SPI by the TEE; this driver gives the
	  HAL /dev/fortsense_fp and IRQ uevents. GPIOs and the supply come
	  from the "fs,fingerprint" node and are claimed only when the HAL
	  asks, so it can share pins with the FPC driver.

	  To compile it as a module, choose M here: the module will be
	  called fortsense_fp.
```

## drivers/input/misc/aw8624_haptic/Kconfig
```kconfig
# SPDX-License-Identifier: GPL-2.0-only
config INPUT_AW8624_HAPTIC
	tristate "Awinic AW8624 haptic driver"
	depends on I2C && OF && GPIOLIB
	help
	  Say Y here if you have the Awinic AW8624 haptic controller (the
	  vibrator on sweet).

	  If unsure, say N.

	  To compile this driver as a module, choose M here.
```

## drivers/input/touchscreen/focaltech_k6/Kconfig
```kconfig
# SPDX-License-Identifier: GPL-2.0-only
#
# Focaltech FT3658U touchscreen (sweet)
#
config TOUCHSCREEN_FTS_K6
	bool "Focaltech FT3658U touchscreen (sweet)"
	depends on I2C && OF && GPIOLIB
	depends on TOUCHSCREEN_XIAOMI_TOUCHFEATURE
	select NEW_TOUCH_GAMEMODE
	help
	  Say Y here if you have the Focaltech FT3658U touch panel found
	  on some sweet units (the others use a Goodix GT9896). The driver
	  identifies the chip at probe and steps aside when it is absent.

	  If unsure, say N.
```

## drivers/input/touchscreen/goodix_gt9896/Kconfig
```kconfig
# SPDX-License-Identifier: GPL-2.0-only
#
# Goodix GT9896 touchscreen (sweet)
#
config TOUCHSCREEN_GOODIX_GTX9896_I2C
	bool "Goodix GT9896 touchscreen (sweet)"
	depends on I2C && OF && GPIOLIB
	help
	  Say Y here if you have the Goodix GT9896 touch controller found
	  on some sweet units (the others use a Focaltech FT3658U). The
	  driver confirms the chip at probe and steps aside when it is
	  absent.

	  If unsure, say N.

if TOUCHSCREEN_GOODIX_GTX9896_I2C

config TOUCHSCREEN_GOODIX_GTX9896_UPDATE
	tristate "Goodix GT9896 firmware update module"
	default y
	help
	  Say Y here to enable support for doing firmware update.

	  If unsure, say N.

config TOUCHSCREEN_GOODIX_GTX9896_GESTURE
	tristate "Goodix GT9896 gesture wakeup feature"
	default y
	help
	  Say Y here to enable support for gesture wakeup feature.

	  If unsure, say N.

config TOUCHSCREEN_GOODIX_GTX9896_TOOLS
	tristate "Goodix GT9896 debug tools and self-test"
	default y
	help
	  Say Y here to enable the debug tools and the self-test.

	  If unsure, say N.

endif
```

## drivers/input/touchscreen/nt36xxx/Kconfig
```kconfig
# SPDX-License-Identifier: GPL-2.0-only
config TOUCHSCREEN_NT36XXX_I2C
	tristate "Novatek NT36xxx I2C touchscreen (Qualcomm touch-drivers copy)"
	depends on I2C && INPUT_TOUCHSCREEN
	help
	  Novatek NT36xxx (e.g. NT36672A TDDI) I2C touch driver, copied from
	  Qualcomm opensource/touch-drivers/nt36xxx for in-kernel builds.
```

## drivers/media/platform/msm/Kconfig
```kconfig
# SPDX-License-Identifier: GPL-2.0-only

source "drivers/media/platform/msm/npu/Kconfig"


config SPECTRA_CAMERA
	bool "Qualcomm Technologies, Inc. Spectra camera and video capture support"
	depends on ARCH_QCOM && VIDEO_DEV && I2C
	select VIDEO_V4L2_SUBDEV_API
	help
	  Say Y here to enable the Spectra camera driver stack (sensor, IFE
	  and postprocessing drivers) forward-ported from the 4.14 sm6150
	  kernel. It keeps the 4.14 UAPI the CamX blobs are built against.

config SPECTRA_CAMERA_UPGRADE
	bool "Spectra camera request manager and ISP changes for sdmmagpie"
	depends on SPECTRA_CAMERA
	help
	  The 4.14 option of the same name (set for sweet, not for violet):
	  the request manager and ISP context changes the sdmmagpie CamX
	  stack expects. The code is in the driver under this symbol.
```

## drivers/nfc/Kconfig
```kconfig
# SPDX-License-Identifier: GPL-2.0-only
#
# Near Field Communication (NFC) devices
#

menu "Near Field Communication (NFC) devices"
	depends on NFC

config NFC_TRF7970A
	tristate "Texas Instruments TRF7970a NFC driver"
	depends on SPI && NFC_DIGITAL && GPIOLIB
	help
	  This option enables the NFC driver for Texas Instruments' TRF7970a
	  device. Such device supports 5 different protocols: ISO14443A,
	  ISO14443B, FeLiCa, ISO15693 and ISO18000-3.

	  Say Y here to compile support for TRF7970a into the kernel or
	  say M  to compile it as a module. The module will be called
	  trf7970a.ko.

config NFC_MEI_PHY
	tristate "MEI bus NFC device support"
	depends on INTEL_MEI && NFC_HCI
	help
	  This adds support to use an mei bus nfc device. Select this if you
	  will use an HCI NFC driver for an NFC chip connected behind an
	  Intel's Management Engine chip.

	  If unsure, say N.

config NFC_SIM
	tristate "NFC hardware simulator driver"
	depends on NFC_DIGITAL
	help
	  This driver declares two virtual NFC devices supporting NFC-DEP
	  protocol. An LLCP connection can be established between them and
	  all packets sent from one device is sent back to the other, acting as
	  loopback devices.

	  If unsure, say N.

config NFC_PORT100
	tristate "Sony NFC Port-100 Series USB device support"
	depends on USB
	depends on NFC_DIGITAL
	help
	  This adds support for Sony Port-100 chip based USB devices such as the
	  RC-S380 dongle.

	  If unsure, say N.

config NFC_VIRTUAL_NCI
	tristate "NCI device simulator driver"
	depends on NFC_NCI
	help
	  NCI virtual device simulates a NCI device to the user.
	  It can be used to validate the NCI module and applications.
	  This driver supports communication between the virtual NCI device and
	  module.

	  If unsure, say N.

source "drivers/nfc/fdp/Kconfig"
source "drivers/nfc/pn544/Kconfig"
source "drivers/nfc/pn533/Kconfig"
source "drivers/nfc/microread/Kconfig"
source "drivers/nfc/nfcmrvl/Kconfig"
source "drivers/nfc/st21nfca/Kconfig"
source "drivers/nfc/st-nci/Kconfig"
source "drivers/nfc/nxp-nci/Kconfig"
source "drivers/nfc/s3fwrn5/Kconfig"
source "drivers/nfc/st95hf/Kconfig"
endmenu

# Outside the menu above: NQ is a character device for the userspace NCI
# stack and does not use the kernel NFC subsystem.
config NFC_NQ_PN80T
	tristate "QTI NCI based NFC Controller Driver for NQ PN80T"
	depends on I2C && OF && GPIOLIB
	help
	  The /dev/nq-nci driver for NQ/PN5xx NFC controllers on I2C (sweet).
	  The NCI protocol is handled by the userspace NFC HAL; this driver
	  only moves data and controls the enable, firmware-download and
	  clock-request lines.
```

## drivers/power/supply/ti/Kconfig
```kconfig
# SPDX-License-Identifier: GPL-2.0-only

config BQ2597X_CHARGE_PUMP
	bool "TI BQ2597x / SC8551 charge pump (Xiaomi)"
	depends on I2C && OF
	help
	  Div-2 switched-capacitor charge pump used for PD/QC3 fast charging
	  on Xiaomi sdmmagpie phones (sweet, toco, tucana). This port only
	  binds the chip, programs its protections and ADC and keeps the
	  switcher off; the PD policy manager that drives it is separate.
```

## drivers/power/supply/xiaomi/Kconfig
```kconfig
# SPDX-License-Identifier: GPL-2.0-only

config XIAOMI_BATT_VERIFY_DS28E16
	bool "Xiaomi ds28e16 battery authentication"
	depends on ARCH_QCOM && OF && GPIOLIB
	help
	  Maxim ds28e16 battery authentication IC on a bit-banged 1-Wire
	  TLMM pin (xiaomi,onewire_gpio + maxim,ds28e16 DT nodes), as used
	  by Xiaomi sm6150/sdmmagpie phones. The result lifts the charger's
	  unverified-battery FCC limit (mi,fcc-batt-unverify-ua).
```
