## techpack/audio/Kconfig
```kconfig
# SPDX-License-Identifier: GPL-2.0-only

config QTI_AUDIO_LAHAINA
	bool "Qualcomm APR audio driver (techpack/audio) for lahaina"
	depends on SND_SOC && ARCH_QCOM && RPMSG && !QCOM_APR
	select SND_SOC_COMPRESS
	select SND_HWDEP
	select REGMAP_MMIO
	select REGMAP_I2C
	help
	  Build the Qualcomm APR/q6 audio-kernel techpack (APR over glink,
	  q6 AFE/ASM/ADM/voice/LSM, ASoC platform and DAI drivers, bolero
	  macros, soundwire, WCD938x and the lahaina machine driver) into
	  the kernel with the lahaina feature set from
	  config/lahainaauto.conf.

config QTI_AUDIO_SM6150
	bool "Qualcomm APR audio driver (techpack/audio) for sm6150 (violet)"
	depends on SND_SOC && ARCH_QCOM && RPMSG && !QCOM_APR && !QTI_AUDIO_LAHAINA
	select SND_SOC_COMPRESS
	select SND_HWDEP
	select REGMAP_MMIO
	select REGMAP_I2C
	help
	  Build the APR/q6 audio-kernel techpack into the kernel with the
	  bengal feature set (bolero macros + WCD937x over soundwire), which
	  matches the sm6150 audio hardware, from config/bengalauto.conf.

if QTI_AUDIO_LAHAINA

config SND_PRI_MI2S_AW882XX
	bool "For aw882xx smartpa pri mi2s config"
	default n
	help
	  Enable it only aw882xx smartpa is connected on pri mi2s.

config SND_ENABLE_QCOM_PMIC_HAPTIC
	bool "Enable qcom pmic haptic"
	default n
	help
	  Enable it when qcom pmic haptic is used.

config HAPTIC_POWER_ON
	bool "haptic when power on"
	default n
	help
	  Enable it when haptic power on.

config AW882XX_DRIVER_V1
	bool "Use aw882xx driver version 1.*"
	default n
	help
	  Enable it only use aw882xx driver version 1.*.

config AW882XX_DUAL_SMARTPA
	bool "Use dual smartpa"
	default n
	help
	  Enable it only use dual smartpa.

config AW882XX_PARAMS_FROM_BIN
	bool "params is stored in bin file"
	default n
	help
	  Enable it only for params of smartPA is stored in bin file.

endif
```

## techpack/display/Kconfig
```kconfig
# SPDX-License-Identifier: GPL-2.0-only

config QTI_DISPLAY
	bool
	depends on DRM && ARCH_QCOM && !DRM_MSM
	select DRM_KMS_HELPER
	select DRM_MIPI_DSI
	select SYNC_FILE
	select QCOM_PANEL_EVENT_NOTIFIER
	help
	  Builds the Qualcomm display-drivers techpack (msm_drm: SDE, DSI,
	  MDSS PLLs, RSC, writeback) into the kernel with the feature set
	  from config/sm6150disp.conf. Selected by the SoC options below.

config QTI_DISPLAY_SM6150
	bool "Qualcomm SDE/DSI display driver (techpack/display) for sm6150"
	depends on DRM && ARCH_QCOM && !DRM_MSM
	select QTI_DISPLAY
	help
	  Build the Qualcomm display-drivers techpack (msm_drm: SDE, DSI,
	  MDSS PLLs, RSC, writeback) into the kernel with the sm6150 feature
	  set from config/sm6150disp.conf. The driver keeps the msm_drm module
	  name, so the msm_drm.dsi_display0= panel selection from the
	  bootloader still applies.

config QTI_DISPLAY_SDMMAGPIE
	bool "Qualcomm SDE/DSI display driver (techpack/display) for sdmmagpie"
	depends on DRM && ARCH_QCOM && !DRM_MSM
	select QTI_DISPLAY
	help
	  The same techpack for sdmmagpie (sm7150): MDSS 5.2, DSI PHY v3.0
	  with its 10nm PLL. The sm6150 feature set (sm6150disp.conf) applies
	  unchanged; the SoC differences come from the device tree.
```

## techpack/video/Kconfig
```kconfig
# SPDX-License-Identifier: GPL-2.0-only

config QTI_VIDEO_SM6150
	bool "Qualcomm msm_vidc video driver (techpack/video) for sm6150"
	depends on ARCH_QCOM && VIDEO_DEV
	select VIDEOBUF2_CORE
	select VIDEOBUF2_V4L2
	select MSM_VIDC_V4L2
	select MSM_VIDC_GOVERNORS
	help
	  Build the msm_vidc V4L2 driver of the 4.14 sm6150 kernel (Venus
	  AR50, VPU 4) into the kernel. The stock OMX/Codec2 components need
	  it, with its 4.14 UAPI, for hardware video decoding and encoding.

config MSM_VIDC_V4L2
	bool

config MSM_VIDC_GOVERNORS
	bool
	select PM_DEVFREQ
```
